processor 16f877
include <p16f877.inc>

valor1 equ h'21' ;
valor2 equ h'22' ;
valor3 equ h'23' ; REGISTROS DEFINIDOS PARA ALMACENAR LOS CONTADORES.
cte1 equ h'ff'   ;
cte2 equ 50h	 ; 
cte3 equ 60h	 ; CONSTANTES QUE DEFINEN EL RETARDO
 	ORG 0
GOTO INICIO
 	ORG 5
INICIO:		 	;INICIO DEL PROGRAMA
	CLRF PORTA	;LIMPIAMOS EL PORTA
	BSF STATUS,RP0	;
 	BCF STATUS,RP1	; CAMBIAMOS AL BANCO 1
 	MOVLW H'00'	;
 	MOVWF TRISB	; CONFIGURAMOS A TRISB COMO SALIDA (8 BITS)
	MOVLW 06H	; 06H,07H <- DIGITALES
	MOVWF ADCON1	; REGISTRO PARA SELECCIONAR SI SON ENTRADAS DIGITALES.
	MOVLW 3FH	;
	MOVWF TRISA	; CONFIGURAMOS A TRISA COMO ENTRADA (6 BITS) 
 	BCF STATUS,RP0 	; CAMBIAMOS AL BANCO 0
	MOVLW B'00000000';
	MOVWF PORTB	;  LIMPIAMOS EL PORTA

	
	
loop1:
	BTFSC PORTA, 0		;CHECAMOS EL PORTA, EN EL BIT 0 (LSB)
	GOTO PRENDER_LEDS	;EN CASO DE QUE ESTE PRENDIDO, VAMOS A 'PRENDER_LEDS'
	GOTO APAGAR_LEDS	;CASO CONTRARIO, VAMOS A 'APAGAR_LEDS'
	goto loop1		;REPETIMOS LOOP.

PRENDER_LEDS:
	MOVLW B'11111111'	;
	MOVWF PORTB		; MANDAMOS A PORTB PUROS BITS ENCENDIDOS
	GOTO loop1		; REGRESAMOS AL LOOP

APAGAR_LEDS
	CLRF PORTB		; APAGAMOS LOS BITS DEL PORTB
	GOTO loop1		; 
	
retardo 
	MOVLW cte1		;
 	MOVWF valor1		;
tres 				
	MOVLW cte2		;
	MOVWF valor2		;
dos 
	MOVLW cte3		;
	MOVWF valor3		;
uno 	
	DECFSZ valor3		;
 	GOTO uno		;
	DECFSZ valor2		;
	GOTO dos		;
	DECFSZ valor1		;
	GOTO tres		;
	RETURN			;
	END			; CODIGO DEL RETARDO.