include <p16f877.inc>
cteA equ 0x20
	ORG 0
GOTO INICIO
	ORG 5
INICIO:
	CLRF PORTA			;Limpiamos el puerto de salida
	BSF STATUS, RP0		;
	BCF STATUS, RP1		; CAMBIAMOS DE BANCO (01)
	CLRF ADCON1			; LIMPIAMOS EL ADCON1
	CLRF PORTD			; LIMPIAMOS EL PORTD
	BCF STATUS, RP0		; CAMBIAMOS AL BANCO (00)
	MOVLW B'11101001'	;
	MOVWF ADCON0		; CONFIGURAMOS EL ADCON1 PARA EL CANAL 5.
LOOP2:	
	BSF ADCON0, 2		; INICIAMOS LA LECTURA
	CALL RETARDO
LOOP:
	BTFSC ADCON0, 2		; PREGUNTAMOS SI YA TERMINÓ DE LEER
	GOTO LOOP 			; EN CASO NEGATIVO, VOLVEMOS A PREGUNTAR.
	MOVF ADRESH, W		; MOVEMOS EL RESULTADO DE ADRESH AL REGISTRO W.
	MOVWF PORTD			; MOVEMOS DEL W AL PUERTO DE SALIDA.
	GOTO LOOP2			; VOLVEMOS AL LOOP2


RETARDO:					;
	MOVLW 0X30				;
	MOVWF cteA				;
LOOPR:						;
	DECFSZ cteA				;
	GOTO LOOPR				;
	RETURN				; CODIGO DEL RETARDO

END