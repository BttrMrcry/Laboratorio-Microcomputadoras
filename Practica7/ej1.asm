
	processor 16f877
	include<p16f877.inc>
	ORG 0
	GOTO INICIO
	ORG 5
INICIO:
;CAMBIA DE BANCO
	BSF STATUS,RP0
	BCF STATUS,RP1
	CLRF TRISB
;TASA ALTA
	BSF TXSTA,BRGH
;TASA DE TRANSFERENCIA	
	MOVLW D'129'
	MOVWF SPBRG
; coMUNICACIсN ASINCR0NA	
	BCF TXSTA,SYNC
;HABILITA EL TRANSMISOR
	BSF TXSTA,TXEN
	BCF STATUS,RP0
;HABILITA EL PUERTO SERIE
	BSF RCSTA,SPEN
;HABILITA LA RECEPCION CONTINUA
	BSF RCSTA,CREN
	CLRF PORTB
RECIBE:
	;ESPERA A QUE LLEGE UN DATO
	BTFSS PIR1,RCIF
	GOTO RECIBE
	MOVF RCREG,W
	;ENVIA LOS DATOS RECIBIDOS PARA TRANSMITIRLO
	MOVWF TXREG
	MOVWF PORTB
	;CAMBIA AL BANCO 1
	BSF STATUS,RP0
TRASMITE:
	;UN LOOP ESPERANDO A QUE SE ENVIEN LOS DATOS
	BTFSS TXSTA,TRMT
	GOTO TRASMITE
	;REGRESA AL BANCO 0
	BCF STATUS,RP0
	GOTO RECIBE
	END