
	processor 16f877
	include<p16f877.inc>
	cteA equ 0x20
	ORG 0
	GOTO INICIO
	ORG 5
INICIO:
;CAMBIA DE BANCO
	BSF STATUS,RP0
	BCF STATUS,RP1
	CLRF TRISB
;TASA ALTA
	BSF TXSTA,BRGH
;TASA DE TRANSFERENCIA	
	MOVLW D'129'
	MOVWF SPBRG
; coMUNICACIсN ASINCR0NA	
	BCF TXSTA,SYNC
;HABILITA EL TRANSMISOR
	BSF TXSTA,TXEN
	BCF STATUS,RP0
;HABILITA EL PUERTO SERIE
	BSF RCSTA,SPEN
;HABILITA LA RECEPCION CONTINUA
	BSF RCSTA,CREN
	CLRF PORTB
RECIBE:
	;ESPERA A QUE LLEGE UN DATO
	BTFSS PIR1,RCIF
	GOTO RECIBE
	MOVLW h'48'
	;ENVIA LOS DATOS RECIBIDOS PARA TRANSMITIRLO
	MOVWF TXREG
	call retardo 
	;CAMBIA AL BANCO 1
	BSF STATUS,RP0
TRASMITE_H:
	BTFSS TXSTA,TRMT
	GOTO TRASMITE_H
	
	BCF STATUS,RP0
	MOVLW h'4F'
	MOVWF TXREG
	call retardo
	BSF STATUS,RP0
TRASMITE_O:
	BTFSS TXSTA,TRMT
	GOTO TRASMITE_O
	
	BCF STATUS,RP0
	MOVLW h'4C'
	MOVWF TXREG
	call retardo
	BSF STATUS,RP0
TRASMITE_L:
	BTFSS TXSTA,TRMT
	GOTO TRASMITE_L

	BCF STATUS,RP0
	MOVLW h'41'
	MOVWF TXREG
	call retardo
	BSF STATUS,RP0
TRASMITE_A:
	BTFSS TXSTA,TRMT
	GOTO TRASMITE_A

	BCF STATUS,RP0
	MOVLW h'20'
	MOVWF TXREG
	call retardo
	BSF STATUS,RP0
TRASMITE_SPACE:
	BTFSS TXSTA,TRMT
	GOTO TRASMITE_SPACE

	BCF STATUS,RP0
	MOVLW h'55'
	MOVWF TXREG
	call retardo
	BSF STATUS,RP0
TRASMITE_U:
	BTFSS TXSTA,TRMT
	GOTO TRASMITE_U

	BCF STATUS,RP0
	MOVLW h'4E'
	MOVWF TXREG
	call retardo
	BSF STATUS,RP0
TRASMITE_N:
	BTFSS TXSTA,TRMT
	GOTO TRASMITE_N

	BCF STATUS,RP0
	MOVLW h'41'
	MOVWF TXREG
	call retardo
	BSF STATUS,RP0
TRASMITE_A_2:
	BTFSS TXSTA,TRMT
	GOTO TRASMITE_A_2

	BCF STATUS,RP0
	MOVLW h'4D'
	MOVWF TXREG
	call retardo
	BSF STATUS,RP0
TRASMITE_M:
	BTFSS TXSTA,TRMT
	GOTO TRASMITE_M

	BCF STATUS,RP0
	MOVLW h'0A'
	MOVWF TXREG
	call retardo
	BSF STATUS,RP0
TRASMITE_SALTO:
	BTFSS TXSTA,TRMT
	GOTO TRASMITE_SALTO

	BCF STATUS,RP0
	MOVLW h'0A'
	MOVWF TXREG
	call retardo
	BSF STATUS,RP0
TRASMITE_SALTO_2:
	BTFSS TXSTA,TRMT
	GOTO TRASMITE_SALTO_2

	;REGRESA AL BANCO 0
	BCF STATUS,RP0
	GOTO RECIBE

retardo:
	MOVLW 0X30
	MOVWF cteA
LOOPR:
	DECFSZ cteA
	GOTO LOOPR
	RETURN

	END